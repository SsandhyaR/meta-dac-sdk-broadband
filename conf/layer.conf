## conf/layer.conf
```bitbake
# We have a conf and classes directory, add to BBPATH
BBPATH .= ":${LAYERDIR}"

# We have recipes-* directories, add to BBFILES
BBFILES += "${LAYERDIR}/recipes-*/*/*.bb \
            ${LAYERDIR}/recipes-*/*/*.bbappend"

BBFILE_COLLECTIONS += "meta-dac"
BBFILE_PATTERN_meta-dac = "^${LAYERDIR}/"
BBFILE_PRIORITY_meta-dac = "6"

LAYERDEPENDS_meta-dac = "core"
LAYERSERIES_COMPAT_meta-dac = "dunfell kirkstone"

DISTRO_FEATURES_remove = " x11"
DISTRO_FEATURES_remove = " kde"
DISTRO_FEATURES_append = " enable_icrypto_openssl"
DISTRO_FEATURES_append = " cobalt_rialto"

RDK_GIT_PROTOCOL = "https"
CMF_GIT_PROTOCOL = "https"
CMF_GIT_BRANCH = "rdk-next"
CMF_GIT_ROOT = "git://code.rdkcentral.com/r"
CMF_GITHUB_MASTER_BRANCH ?= "master"
CMF_GITHUB_ROOT ?= "git://github.com/rdkcentral"
RDK_RELEASE ?= "6.1"

EXTRA_VERSIONS_PATH ?= "${TMPDIR}/versions"

BBMASK += "/meta-rdk/"
BBMASK += "/meta-cmf/(?!recipes-extended|recipes-devtools)"
BBMASK += "/meta-cmf/recipes-extended/(?!rpcserver)"
BBMASK += "/meta-cmf/recipes-devtools/"

BBMASK += "/meta-rdk-ext/(?!recipes-devtools|recipes-extended|recipes-multimedia)"
BBMASK += "/meta-rdk-ext/recipes-extended/(?!graphite2|curl-netflix)"
BBMASK += "/meta-rdk-ext/recipes-devtools/(?!dwarfutils)"
# cobalt-24 needs gstreamer 1.18 inside /meta-rdk-ext/recipes-multimedia/gstreamer
# in other cases we use gstreamer 1.16 in meta-openembedded
BBMASK += "${@bb.utils.contains('DISTRO_FEATURES', 'cobalt-24', '/meta-rdk-ext/recipes-multimedia/(?!gstreamer)', '/meta-rdk-ext/recipes-multimedia/', d)}"
```
